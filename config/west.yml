## config/west.yml
```yaml
manifest:
  defaults:
     revision: v0.3
  remotes:
    - name: zmkfirmware
      url-base: https://github.com/zmkfirmware
    - name: 9u0vad15
      url-base: https://github.com/9u0vad15
   
  projects:
    - name: zmk
      remote: zmkfirmware
      revision: main
      import: app/west.yml
    
    - name: zmk-pim447
      remote: 9u0vad15
      revision: main
  self:
    path: config
```
