#include "corne.dtsi"
#include <dt-bindings/behavior_pim447.h>

&default_transform {
	col-offset = <6>;
};

&kscan0 {
	col-gpios
		= <&pro_micro 14 GPIO_ACTIVE_HIGH>
		, <&pro_micro 15 GPIO_ACTIVE_HIGH>
		, <&pro_micro 18 GPIO_ACTIVE_HIGH>
		, <&pro_micro 19 GPIO_ACTIVE_HIGH>
		, <&pro_micro 20 GPIO_ACTIVE_HIGH>
		, <&pro_micro 21 GPIO_ACTIVE_HIGH>
		;
};

&i2c0 {
    status = "okay";
    
    trackball_pim447: trackball@0A {
        compatible = "pimoroni,trackball_pim447";
        reg = <0x0A>;
        sensitivity = <64>;  /* Range: 1-255 */
        move-factor = <2>;   /* Range: 1-10, scales cursor movement speed */
        scroll-factor = <1>; /* Range: 1-10, scales scrolling speed */
        
        /* Optional LED color (RGB values 0-255) */
        led-red = <255>;
        led-green = <0>;
        led-blue = <0>;
        
        /* Optional axis inversion */
        invert-x;  /* Uncomment to invert X axis */
        /* invert-y; */  /* Uncomment to invert Y axis */
        int-gpios = <&gpio1 7 (GPIO_PULL_UP | GPIO_ACTIVE_LOW)>;
        };
};
